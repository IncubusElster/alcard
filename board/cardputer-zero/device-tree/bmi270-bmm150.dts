/* SPDX-License-Identifier: GPL-2.0-only
 * Alcard full Zero v5 IMU + AUX magnetometer overlay.
 * Derived from M5Stack imu-1.0/bmi270_bmm150_overlay.dts
 * M5Stack BSP commit 4f7aeee9fc103ebb03d22cac476bb191ecfb321e.
 * The BMM150 is behind BMI270 AUX, not a direct SoC I2C device.
 */
/dts-v1/;
/plugin/;

/ {
    compatible = "brcm,bcm2835";

    fragment@0 {
        target = <&i2c1>;
        __overlay__ {
            #address-cells = <1>;
            #size-cells = <0>;
            status = "okay";

            bmi270: imu@68 {
                compatible = "bosch,bmi270";
                reg = <0x68>;
                status = "okay";
            };
        };
    };

    fragment@1 {
        target-path = "/";
        __overlay__ {
            /*
             * The BMM150 is accessed through BMI270 AUX, not through
             * the root address space. This is a platform bridge device;
             * reg=<0x10> under / is invalid. The matching vendor bridge
             * source patch reads this explicit AUX I2C address.
             */
            bmm150: magnetometer {
                compatible = "bosch,bmm150-bmi270";
                bmi270-parent = <&bmi270>;
                bosch,aux-i2c-addr = <0x10>;
                status = "okay";
            };
        };
    };
};
